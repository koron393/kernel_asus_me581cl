## linux/kernel/drivers/misc/slimport_anx7814/Kconfig
```kconfig
config SLIMPORT_ANX7814
	tristate "Analogix Slimport transmitter ANX7814 support"
	help
		Slimport Transmitter is a HD video transmitter chip
		over micro-USB connector for smartphone device.
```

## linux/kernel/drivers/net/wireless/bcm43xx/Kconfig
```kconfig
config BCM43XX
	tristate "Broadcom 4329/30 wireless cards support"
	depends on MMC
	default m
	---help---
	  This module adds support for wireless adapters based on
	  Broadcom 4329/30 chipset.

	  This driver uses the kernel's wireless extensions subsystem.

	  If you choose to build a module, it'll be called dhd. Say M if
	  unsure.

config BCM4339
	bool "Broadcom 4339 wireless cards support"
	depends on BCM43XX
	---help---
	  This module adds support for wireless adapters based on
	  Broadcom 4339 chipset.

config BCM4334X
	bool "Broadcom 43340/43341 wireless cards support"
	depends on BCM43XX
	---help---
	  This module adds support for wireless adapters based on
	  Broadcom 43340/341 chipset.

config BCM43362
	bool "Broadcom 43362 wireless cards support"
	depends on BCM43XX
	---help---
	  This module adds support for wireless adapters based on
	  Broadcom 43362 chipset.

config INTEL_PLATFORM
	bool "Enable Intel specific flags"
	depends on BCM43XX
	default y
	---help---
	        Enable Intel specific flags

config BCM43XX_FW_PATH
	depends on BCM43XX
	string "Firmware path"
	default "/system/etc/firmware/fw_bcmdhd.bin"
	---help---
	  Path to the firmware file.

config BCM43XX_NVRAM_PATH
	depends on BCM43XX
	string "NVRAM path"
	default "/data/misc/wifi/nvram.txt"
	---help---
	  Path to the calibration file.

config BCM43XX_WEXT
	bool "Enable WEXT support"
	depends on BCM43XX && CFG80211 = n
	select WIRELESS_EXT
	select WEXT_PRIV
	help
	  Enables WEXT support

config DHD_USE_STATIC_BUF
	bool "Enable memory preallocation"
	depends on BCM43XX
	default n
	---help---
	  Use memory preallocated in platform

config DHD_USE_SCHED_SCAN
	bool "Use CFG80211 sched scan"
	depends on BCM43XX && CFG80211
	default y
	---help---
	  Use CFG80211 sched scan
```

## linux/modules/drivers/input/touchscreen/Kconfig
```kconfig
config TOUCHSCREEN_ATMEL_MXT224
	tristate "ATMEL mXT224 touchscreen"
	depends on I2C
	default n
	help
		Say Y here if you have a mXT224 touchscreen
		If unsure, say N.

config TOUCHSCREEN_ATMEL_MXT_FORK
	tristate "Atmel mXT I2C Touchscreen"
	depends on I2C
	default n
	help
	  Say Y here if you have Atmel mXT series I2C touchscreen,
	  such as ATMXT1664S/ATMXT3432S, connected to your system.

	  If unsure, say N.

	  To compile this driver as a module, choose M here: the
	  module will be called atmel_mxt_ts.

config TOUCHSCREEN_ATMEL_MXT_TS
	tristate "ATMEL MXT touchscreen"
	depends on I2C
	default y
	help
		Say Y here if you have a mXT2952t2 touchscreen
		If unsure, say N.

config TOUCHSCREEN_HIMAX_HX8528_E58
	tristate "Himax HX8528 E58 touchscreen"
	depends on I2C
	default y
	help
		Say Y here if you have a HX8528_E58 touchscreen
		If unsure, say N.

source "drivers/external_drivers/drivers/input/touchscreen/rmi4/Kconfig"
source "drivers/external_drivers/drivers/input/touchscreen/synaptics_dsx/Kconfig"
```
